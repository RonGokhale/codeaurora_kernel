/* Copyright (c) 2012, The Linux Foundation. All rights reserved.
 *
 * This program is free software; you can redistribute it and/or modify
 * it under the terms of the GNU General Public License version 2 and
 * only version 2 as published by the Free Software Foundation.
 *
 * This program is distributed in the hope that it will be useful,
 * but WITHOUT ANY WARRANTY; without even the implied warranty of
 * MERCHANTABILITY or FITNESS FOR A PARTICULAR PURPOSE.  See the
 * GNU General Public License for more details.
 */

&soc {

	qcom,mdss_dsi_jdi_dualmipi1_video {
		compatible = "qcom,mdss-dsi-panel";
		label = "JDI dualmipi video mode dsi1 panel";
		status = "disable";
		qcom,dsi-ctrl-phandle = <&mdss_dsi1>;
		qcom,mdss-pan-res = <1280 1600>;
		qcom,mdss-pan-bpp = <24>;
		qcom,mdss-pan-dest = "display_2";
		qcom,mdss-pan-broadcast-mode = <1>;
		qcom,mdss-pan-porch-values = <80 12 164 4 4 12>;
		qcom,mdss-pan-underflow-clr = <0xff>;
		qcom,mdss-pan-bl-ctrl = "bl_ctrl_wled";
		qcom,mdss-pan-bl-levels = <1 255>;
		qcom,mdss-pan-dsi-mode = <0>;
		qcom,mdss-pan-dsi-h-pulse-mode = <0>;
		qcom,mdss-pan-dsi-h-power-stop = <0 0 0>;
		qcom,mdss-pan-dsi-bllp-power-stop = <1 1>;
		qcom,mdss-pan-dsi-traffic-mode = <1>;
		qcom,mdss-pan-dsi-dst-format = <3>;
		qcom,mdss-pan-dsi-vc = <0>;
		qcom,mdss-pan-dsi-rgb-swap = <0>;
		qcom,mdss-pan-dsi-data-lanes = <1 1 1 1>;
		qcom,mdss-pan-dsi-dlane-swap = <2>;
		qcom,mdss-pan-dsi-t-clk = <0x2c 0x3>;
		qcom,mdss-pan-dsi-stream = <0>;
		qcom,mdss-pan-dsi-mdp-tr = <0x0>;
		qcom,mdss-pan-dsi-dma-tr = <0x04>;
		qcom,mdss-pan-frame-rate = <60>;
		qcom,panel-phy-regulatorSettings = [07 09 03 00  /* Regualotor settings */
						    20 00 01];
		qcom,panel-phy-timingSettings = [ef 38 25 00 67 70
						    29 3c 2c 03 04 00];
		qcom,panel-phy-strengthCtrl = [ff 06];
		qcom,panel-phy-bistCtrl = [00 00 b1 ff           /* BIST Ctrl settings */
					   00 00];
		qcom,panel-phy-laneConfig = [00 00 00 00 00 00 00 01 97 /* lane0 config */
					     00 00 00 00 05 00 00 01 97 /* lane1 config */
					     00 00 00 00 0a 00 00 01 97 /* lane2 config */
					     00 00 00 00 0f 00 00 01 97 /* lane3 config */
					     00 c0 00 00 00 00 00 01 bb]; /* Clk ln config */

		qcom,panel-on-cmds =   [05 01 00 00 0a 00 01 01       /* Soft reset, wait 10ms */
					15 01 00 00 00 00 02 3a 77    /* Set Pixel format (24bits/pixel), no wait */
					39 01 00 00 00 00 05
						2a 00 00 04 ff     /* Set Column address (0->1280) */
					39 01 00 00 00 00 05
						2b 00 00 06 3f     /* Set page address */
					15 01 00 00 00 00 02 35 00    /* Set tear on */
					39 01 00 00 00 00 03 44 00 00 /* Set tear scan line */
					15 01 00 00 00 00 02 51 ff    /* write display brightness */
					15 01 00 00 00 00 02 53 24    /* write control brightness */
					05 01 00 00 78 00 01 11       /* exit sleep mode, wait 120ms */
					23 01 00 00 00 00 02 b0 00    /* MCAP */
					29 01 00 00 00 00 02 b3 14    /* Interface setting */
					23 01 00 00 00 00 02 b0 03    /* MCAP */
					05 01 00 00 10 00 01 29];     /* Set display on, wait 16ms */
		qcom,on-cmds-dsi-state = "DSI_LP_MODE";
		qcom,panel-off-cmds = [05 01 00 00 32 00 02 28 00
					05 01 00 00 78 00 02 10 00];
		qcom,off-cmds-dsi-state = "DSI_HS_MODE";
				qcom,mdss-pan-psr-mode;
		qcom,panel-psr-on-cmds = [23 00 00 00 00 00 02 b0 00
								29 00 00 00 00 00 02 b3 0c
								23 01 00 00 00 00 02 b0 03];
								
		qcom,psr-on-cmds-dsi-state = "DSI_HS_MODE";
		qcom,panel-psr-off-cmds = [23 00 00 00 00 00 02 b0 00
									29 00 00 00 00 00 02 b3 1c
									23 01 00 00 00 00 02 b0 03];
		qcom,psr-off-cmds-dsi-state = "DSI_HS_MODE";
	};
};
