/* Copyright (c) 2013, The Linux Foundation. All rights reserved.
 *
 * This program is free software; you can redistribute it and/or modify
 * it under the terms of the GNU General Public License version 2 and
 * only version 2 as published by the Free Software Foundation.
 *
 * This program is distributed in the hope that it will be useful,
 * but WITHOUT ANY WARRANTY; without even the implied warranty of
 * MERCHANTABILITY or FITNESS FOR A PARTICULAR PURPOSE.  See the
 * GNU General Public License for more details.
 */

&mdss_mdp {
	dsi_dual0_jdi_video: qcom,mdss_dsi_jdi_dualmipi0_video {
		qcom,mdss-dsi-panel-name = "Dual 0 video mode dsi panel";
		qcom,mdss-dsi-panel-controller = <&mdss_dsi0>;
		qcom,mdss-dsi-panel-type = "dsi_video_mode";
		qcom,mdss-dsi-panel-destination = "display_1";
		qcom,mdss-dsi-panel-framerate = <60>;
		qcom,mdss-dsi-virtual-channel-id = <0>;
		qcom,mdss-dsi-stream = <0>;
		qcom,mdss-dsi-panel-width = <1280>;
		qcom,mdss-dsi-panel-height = <1600>;
		qcom,mdss-dsi-h-front-porch = <164>;
		qcom,mdss-dsi-h-back-porch = <80>;
		qcom,mdss-dsi-h-pulse-width = <12>;
		qcom,mdss-dsi-h-sync-skew = <0>; // not found
		qcom,mdss-dsi-v-back-porch = <4>;
		qcom,mdss-dsi-v-front-porch = <12>;
		qcom,mdss-dsi-v-pulse-width = <4>;
		qcom,mdss-dsi-h-left-border = <0>; // not found
		qcom,mdss-dsi-h-right-border = <0>; // not found
		qcom,mdss-dsi-v-top-border = <0>; // not found
		qcom,mdss-dsi-v-bottom-border = <0>; // not found
		qcom,mdss-dsi-bpp = <24>;
		qcom,mdss-dsi-color-order = "rgb_swap_rgb";
		qcom,mdss-dsi-underflow-color = <0xff>;
		qcom,mdss-dsi-border-color = <0>;
		qcom,mdss-dsi-h-sync-pulse = <0>;
		qcom,mdss-dsi-traffic-mode = "non_burst_sync_event";
		qcom,mdss-dsi-lane-map = "lane_map_2103";
		qcom,mdss-dsi-bllp-eof-power-mode;
		qcom,mdss-dsi-bllp-power-mode;
		qcom,mdss-dsi-panel-broadcast-mode;
		qcom,mdss-dsi-lane-0-state;
		qcom,mdss-dsi-lane-1-state;
		qcom,mdss-dsi-lane-2-state;
		qcom,mdss-dsi-lane-3-state;
		qcom,mdss-dsi-panel-timings = [ef 38 25 00 67 70 29 3c 2c 03
									04 00];
		qcom,mdss-dsi-t-clk-post = <0x03>;
		qcom,mdss-dsi-t-clk-pre = <0x2c>;
		qcom,mdss-dsi-bl-min-level = <1>;
		qcom,mdss-dsi-bl-max-level = <255>;
		qcom,mdss-dsi-dma-trigger = "trigger_sw"; /* code does not have this but effect is same */
		qcom,mdss-dsi-mdp-trigger = "none";
		qcom,mdss-dsi-bl-pmic-control-type = "bl_ctrl_wled";
		qcom,mdss-dsi-on-command = [05 01 00 00 0a 00 01 01  /* Soft reset, wait 10ms */
					15 01 00 00 00 00 02 3a 77    /* Set Pixel format (24bits/pixel), no wait */
					39 01 00 00 00 00 05
						2a 00 00 04 ff        /* Set Column address (0->1280) */
					39 01 00 00 00 00 05
						2b 00 00 06 3f        /* Set page address */
					15 01 00 00 00 00 02 35 00    /* Set tear on */
					39 01 00 00 00 00 03 44 00 00 /* Set tear scan line */
					15 01 00 00 00 00 02 51 ff    /* write display brightness */
					15 01 00 00 00 00 02 53 24    /* write control brightness */
					05 01 00 00 78 00 01 11       /* exit sleep mode, wait 120ms */
					23 01 00 00 00 00 02 b0 00    /* MCAP */
					29 01 00 00 00 00 02 b3 14    /* Interface setting */
					23 01 00 00 00 00 02 b0 03    /* MCAP */
					05 01 00 00 10 00 01 29];     /* Set display on, wait 16ms */
		qcom,mdss-dsi-on-command-state = "dsi_lp_mode";
		qcom,mdss-dsi-off-command = [05 01 00 00 32 00 02 28 00
					05 01 00 00 78 00 02 10 00];
		qcom,mdss-dsi-off-command-state = "dsi_hs_mode";
	//	qcom,mdss-dsi-reset-sequence = <1 20>, <0 200>, <1 20>;
	};
};
