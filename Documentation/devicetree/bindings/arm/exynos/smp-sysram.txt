## Documentation/devicetree/bindings/arm/exynos/smp-sysram.txt
```
Samsung Exynos SYSRAM for SMP bringup:
------------------------------------

Samsung SMP-capable Exynos SoCs use part of the SYSRAM for the bringup
of the secondary cores. Once the core gets powered up it executes the
code that is residing at some specific location of the SYSRAM.

Therefore reserved section sub-nodes have to be added to the mmio-sysram
declaration. These nodes are of two types depending upon secure or
non-secure execution environment.

Required sub-node properties:
- compatible : depending upon boot mode, should be
		"samsung,exynos4210-sysram" : for Secure SYSRAM
		"samsung,exynos4210-sysram-ns" : for Non-secure SYSRAM

The rest of the properties should follow the generic mmio-sysram discription
found in ../../misc/sysram.txt

Example:

	sysram@02020000 {
		compatible = "mmio-sysram";
		reg = <0x02020000 0x54000>;
		#address-cells = <1>;
		#size-cells = <1>;
		ranges = <0 0x02020000 0x54000>;

		smp-sysram@0 {
			compatible = "samsung,exynos4210-sysram";
			reg = <0x0 0x1000>;
		};

		smp-sysram@53000 {
			compatible = "samsung,exynos4210-sysram-ns";
			reg = <0x53000 0x1000>;
		};
	};
```

## Documentation/devicetree/bindings/arm/msm/imem.txt
```
Qualcomm IMEM

IMEM is fast on-chip memory used for various debug features


Required properties

-compatible: "qcom,msm-imem"
-reg: start address and size of imem memory

Example:

	qcom,msm-imem@deadbeef {
		compatible = "qcom,msm-imem";
		reg = <0xdeadbeef 0x1000>; /* < start_address size > */
	};
```

## Documentation/devicetree/bindings/arm/vexpress-scc.txt
```
* ARM Versatile Express Serial Configuration Controller device tree bindings

Latest ARM development boards implement a serial configuration interface (SCC)
that can be used to retrieve temperature sensors, energy/voltage/current
probes and oscillators values through the SYS configuration protocol defined
for versatile express motherboards.
It also provides a power management interface (serial power controller - SPC)
that is capable of managing power/voltage and operating points transitions,
wake-up IRQs and resume addresses for ARM multiprocessor testchips.

The SCC DT bindings are defined as follows:

- scc node

	- compatible:
		Usage: required
		Value type: <stringlist>
		Definition: must be
			    "arm,vexpress-scc,v2p-ca15_a7", "arm,vexpress-scc"
	- reg:
		Usage: required
		Value type: <prop-encode-array>
		Definition: A standard property that specifies the base address
			    and the size of the SCC address space
	- interrupts:
		Usage: required
		Value type: <prop-encoded-array>
		Definition:  SCC interrupt configuration. A standard property
			     that follows ePAPR interrupts specifications

Example:

scc: scc@7fff0000 {
	compatible = "arm,vexpress-scc,v2p-ca15_a7", "arm,vexpress-scc";
	reg = <0x7fff0000 0x1000>;
	interrupts = <0 95 4>;
};
```

## Documentation/devicetree/bindings/arm/vexpress-spc.txt
```
* ARM Versatile Express Serial Power Controller device tree bindings

Latest ARM development boards implement a power management interface (serial
power controller - SPC) that is capable of managing power states transitions,
wake-up IRQs and resume addresses for ARM multiprocessor testchips.
The serial controller can be programmed through a memory mapped interface
that enables communication between firmware running on the microcontroller
managing power states and the application processors.

The SPC DT bindings are defined as follows:

- spc node

	- compatible:
		Usage: required
		Value type: <stringlist>
		Definition: must be
			    "arm,vexpress-spc,v2p-ca15_a7", "arm,vexpress-spc"
	- reg:
		Usage: required
		Value type: <prop-encode-array>
		Definition: A standard property that specifies the base address
			    and the size of the SPC address space
	- interrupts:
		Usage: required
		Value type: <prop-encoded-array>
		Definition:  SPC interrupt configuration. A standard property
			     that follows ePAPR interrupts specifications

Example:

spc: spc@7fff0000 {
	compatible = "arm,vexpress-spc,v2p-ca15_a7", "arm,vexpress-spc";
	reg = <0x7fff0000 0x1000>;
	interrupts = <0 95 4>;
};
```

## Documentation/devicetree/bindings/clock/berlin2-clock.txt
```
* Marvell Berlin2 clock bindings

Marvell Berlin2 (BG2, BG2CD, BG2Q) share the same IP for PLLs and clocks,
with some minor differences in features and register layout. The below
describes the individual clock related IP:

* Audio/Video PLL

The Audio/Video PLL (AVPLL) is a dual-VCO PLL with 8 channels each. Each
of the VCOs can sythesize a single VCO frequency based on a single input
reference clock. Each of the 8 channels then, can derive an output clock
from that VCO frequency by various dividers/multipliers.

Required properties:
- compatible: shall be "marvell,berlin2-avpll"
- reg: address and length of the corresponding AVPLL registers
- #clock-cells: shall be set to 2
- clocks: single clock specifier referencing the AVPLL input clock

To ease match-up with the desired AVPLL output clock, clock specifiers
referencing AVPLL clocks shall contain two cells. The first refers to
the VCO (0=AVPLL_A, 1=AVPLL_B) while the second refers to the corresponding
channel starting with 1. For example, to reference AVPLL_B3 the clock
specifier shall be: <&avpll 1 3>.

Example:

avpll: pll@ea0040 {
	compatible = "marvell,berlin2-avpll";
	#clock-cells = <2>;
	reg = <0xea0050 0x100>;
	clocks = <&refclk>;
};

* Simple PLLs

Simple PLLs are memory mapped PLLs that can sythesize a single output clock
based on a single input reference clock.

Required properties:
- compatible: shall be one of the following:
	"marvell,berlin2-pll" for Berlin BG2/BG2CD PLLs
	"marvell,berlin2q-pll" for Berlin BG2Q PLLs
- reg: address and length of the corresponding PLL registers
- #clock-cells: shall be set to 0
- clocks: single clock specifier referencing the PLL input clock

Example:

cpupll: pll@ea003c {
	compatible = "marvell,berlin2-pll";
	#clock-cells = <0>;
	reg = <0xea003c 0x14>;
	clocks = <&refclk>;
};

* Single-register clock dividers

Single-register clock dividers are complex divider cells, allowing
to divide a reference clock with a set of fixed dividers. Also they
comprise and input clock mux with bypass and an ouput clock gate.

Required properties:
- compatible: shall be "marvell,berlin2-clk-div"
- reg: address and length of the corresponding DIV registers
- #clock-cells: shall be set to 0
- clocks: clock specifiers referencing the DIV input clocks
- clock-names: array of strings describing the clock specifiers above.
    Allowed clock-names are "mux_bypass" for the clock mux bypass selection
    and "muxN" (N=0..7) for each of the 8 possible clock mux inputs.

Example:

gfx3dcore_clk: clock@ea022c {
	compatible = "marvell,berlin2-clk-div";
	#clock-cells = <0>;
	reg = <0xea0022c 0x4>;
	clocks = <&syspll>,
		<&avpll AVPLL_B 4>, <&avpll AVPLL_B 5>,
		<&avpll AVPLL_B 6>, <&avpll AVPLL_B 7>;
	clock-names = "mux_bypass",
		"mux0", "mux1", "mux2", "mux3";
};

* SoC-specific core clocks

In addition to the above, there is a register set dealing with SoC
specific clock dividers, muxes, and gates. There is also the complex
divider cell used above, but instead of independent registers, they
share a common set of registers. The core clocks are represented by
a single DT node providing access to the remaining clocks.

Required properties:
- compatible: shall be one of
	"marvell,berlin2-core-clocks" for BG2/BG2CD SoCs
	"marvell,berlin2q-core-clocks" for BG2Q SoCs
- reg: address and length of the corresponding clock registers
- #clock-cells: shall be set to 1
- clocks: clock specifiers referencing the core clock input clocks
- clock-names: array of strings describing the clock specifiers above.
    Allowed clock-names for the reference clocks are
      "refclk", "syspll", "mempll", "cpupll"
    also Audio/Video PLL clocks shall be named with
      "avpll_VN" (V=0...1 for AVPLL_A and AVPLL_B, N=1..8 for the
      corresponding reference input from AVPLL).

Optional properties for BG2/BG2CD SoCs:
- clocks/clock-names: in addition to the allowed clock names above,
    there is an external video clock input that shall be named "video_ext0".

Clocks provided by core clocks shall be referenced by a clock specifier
indexing one of the provided clocks. A SoC-specific list of available clocks
is below the example.

Example:
coreclk: clock@ea0150 {
	compatible = "marvell,berlin2-core-clocks";
	#clock-cells = <1>;
	reg = <0xea0150 0x1c>;
	clocks = <&refclk>, <&syspll>, <&mempll>, <&cpupll>,
		<&avpll 0 1>, <&avpll 0 2>,
		<&avpll 0 3>, <&avpll 0 4>,
		<&avpll 0 5>, <&avpll 0 6>,
		<&avpll 0 7>, <&avpll 0 8>,
		<&avpll 1 1>, <&avpll 1 2>,
		<&avpll 1 3>, <&avpll 1 4>,
		<&avpll 1 5>, <&avpll 1 6>,
		<&avpll 1 7>, <&avpll 1 8>,
		<&externalvideoclk>;
	clock-names = "refclk", "syspll", "mempll", "cpupll",
		"avpll_a1", "avpll_a2", "avpll_a3", "avpll_a4",
		"avpll_a5", "avpll_a6", "avpll_a7", "avpll_a8",
		"avpll_b1", "avpll_b2", "avpll_b3", "avpll_b4",
		"avpll_b5", "avpll_b6", "avpll_b7", "avpll_b8",
		"video_ext0";
};

* BG2/BG2CD core clock indicies:
0  - SYS
1  - CPU
2  - DRMFIGO
3  - CFG
4  - GFX
5  - ZSP
6  - PERIF
7  - PCUBE
8  - VSCOPE
9  - NFC_ECC
10 - VPP
11 - APP
12 - AUDIO0
23 - AUDIO2
14 - AUDIO3
15 - AUDIO1
16 - GETH0
17 - GETH1
18 - SATA
19 - AHBAPB
20 - USB0
21 - USB1
22 - PBRIDGE
23 - SDIO0
24 - SDIO1
25 - NFC
26 - SMEMC
27 - AUDIOHD
28 - VIDEO0
29 - VIDEO1
30 - VIDEO2
```

## Documentation/devicetree/bindings/i2c/i2c-mv64xxx.txt
```
* Marvell MV64XXX I2C controller

Required properties :

 - reg             : Offset and length of the register set for the device
 - compatible      : Should be "allwinner,sun4i-i2c", or "marvell,mv64xxx-i2c"
and "marvell,mv7230-i2c" for controller which support the I2C Transaction
Generator
 - interrupts      : The interrupt number

Optional properties :

 - clock-frequency : Desired I2C bus clock frequency in Hz. If not set the
default frequency is 100kHz

Examples:

	i2c@11000 {
		compatible = "marvell,mv64xxx-i2c";
		reg = <0x11000 0x20>;
		interrupts = <29>;
		clock-frequency = <100000>;
	};

For a controller which support the I2C Transaction Generator:

	i2c@11000 {
		compatible = "marvell,mv78230-i2c", "marvell,mv64xxx-i2c";
		reg = <0x11000 0x100>;
		compatible = "marvell,mv64xxx-i2c";
		interrupts = <29>;
		clock-frequency = <100000>;
	};
```

## Documentation/devicetree/bindings/media/video/msm-vpu.txt
```
* Qualcomm MSM VPU

Required properties:
- compatible : one of:
    - "qcom,vpu"
- reg : Specify offset and length of the device register sets.
- reg-names : Names corresponding to the defined register sets.
    - "maple_csr_reg" : Maple CSR registers
    - "maple_smem_reg" : Maple shared memory registers
- interrupts : Specify the vpu interrupts.
- interrupt-names : Names corresponding to the defined interrupts list.
    - "maple_wdog_irq" : Watch dog interrupt
    - "maple_apps_irq" " Maple to Host interrupt

- qcom,maple-clk-load-freq-tbl: Table of <load, freq> entries. An entry
  specifies a given VPU processing load (in bits per second), and a
  corresponding clock frequency (in Hz) to set. Entries should be in ascending
  order of load, and their number is variable. For maple clock.
- qcom,vdp-clk-load-freq-tbl: Same as above, for vdp clock.
- qcom,bus-clk-load-freq-tbl: Same as above, for bus clock.
- qcom,bus-load-vector-tbl: Vectors of <load, ab, ib>. The (ab,ib) pairs are
  ddr bus bandwidths to be requested at corresponding video processing load.
  Vectors should be in ascending order of load, and their number is variable.
- qcom,enabled-iommu-maps: list of IOMMU map names that should be enabled.
    - "vpu_nonsecure" : Non-secure video data IOMMU
    - "vpu_secure" : Secure video data IOMMU
    - "vpu_firmware" : Maple Firmware loading IOMMU
- vdd-supply: regulator that supplies vpu.


Example:

	qcom,vpu@fdc00000 {
		compatible = "qcom,vpu";
		reg = <0xfdc00000 0xff000>,
			<0xbfe00000 0x100000>;
		reg-names = "maple_csr_reg", "maple_smem_reg";
		interrupts = <0 44 0>, <0 45 0>;
		interrupt-names = "maple_wdog_irq", "maple_apps_irq";
		qcom,maple-clk-load-freq-tbl = <100000 50000000>,
			<500000 400000000>;
		qcom,vdp-clk-load-freq-tbl = <200000 100000000>,
			<400000 320000000>;
		qcom,bus-clk-load-freq-tbl = <100000 40000000>,
			<200000 80000000>;
		qcom,bus-load-vector-tbl = <0 0 0>,
			<489600 536000 1600000>,
			<979200 2024000 1600000>;
		qcom,enabled-iommu-maps = "vpu_nonsecure", "vpu_secure";
		vdd-supply = <&gdsc_vpu>;
	};
```

## Documentation/devicetree/bindings/mfd/max77802.txt
```
Maxim MAX77802 multi-function device

MAX77802 is a Mulitifunction device with PMIC, RTC and Charger on chip. It is
interfaced to host controller using i2c interface. PMIC, Charger and RTC
submodules are addressed using same i2c slave address

This document describes the binding for mfd device and PMIC submodule.

Binding for the built-in 32k clock generator block is defined separately
in bindings/clk/maxim,max77802.txt file.

Required properties:
- compatible : Must be "maxim,max77802";
- reg : Specifies the i2c slave address of PMIC block.
- interrupts : This i2c device has an IRQ line connected to the main SoC.
- interrupt-parent : The parent interrupt controller.

Optional properties:
- max77802,pmic-buck-default-dvs-idx: We'll always write this DVS index in the
  PMIC for BUCKs with DVS (Bucks 1-4, 6).
  NOTE: at the moment these bindings don't include enough details for actual
  GPIO-DVS--this just lets you choose which single slot to use.

- max77802,pmic-buck-dvs-gpios: The DVS GPIOs. We'll try to set these GPIOs
  to match pmic-buck-default-dvs-idx at probe time if they are defined. If
  some or all of these GPIOs are not defined it's assumed that the board has
  any missing GPIOs hardwired to match pmic-buck-default-dvs-idx.

- max77802,pmic-buck-selb-gpios: GPIOs to enable DVS-GPIO for BUCKs.
  Should be five values: 1, 2, 3, 4, 6.  It is strongly suggested to include
  these GPIOs if there's any chance that changing DVS GPIOs one line at a
  time might glitch your DVS values.

Optional node:
- regulators : The regulators of max77802 have to be instantiated
  under subnode named "regulators" using the following format.

	regulator_name {
		standard regulator constraints....
	};
	refer Documentation/devicetree/bindings/regulator/regulator.txt

  The regulator node name should be initialized with a string
to get matched with their hardware counterparts as follow:

	-LDOn 	:	for LDOs, where n can lie in range 1 to 35.
			example: LDO1, LDO2, LDO35.
	-BUCKn 	:	for BUCKs, where n can lie in range 1 to 10.
			example: BUCK1, BUCK5, BUCK10.
Example:

	max77802@09 {
		compatible = "maxim,max77802";
		interrupt-parent = <&wakeup_eint>;
		interrupts = <26 0>;
		reg = <0x09>;
		#address-cells = <1>;
		#size-cells = <0>;

		max77802,pmic-buck-default-dvs-idx = <1>;
		max77802,pmic-buck-dvs-gpios = <&gpy7 6 0>,
					       <&gpj4 2 0>,
					       <&gpj4 3 0>;
		max77802,pmic-buck-selb-gpios = <&gph0 2 0>,
						<&gph0 3 0>,
						<&gph0 4 0>,
						<&gph0 5 0>,
						<&gph0 6 0>;

		regulators {
			ldo11_reg: LDO11 {
				regulator-compatible = "LDO11";
				regulator-name = "vdd_ldo11";
				regulator-min-microvolt = <1900000>;
				regulator-max-microvolt = <1900000>;
				regulator-always-on;
			};

			buck1_reg {
				regulator-compatible = "BUCK1";
				regulator-name = "vdd_mif";
				regulator-min-microvolt = <950000>;
				regulator-max-microvolt = <1300000>;
				regulator-always-on;
				regulator-boot-on;
			};
	};
```
