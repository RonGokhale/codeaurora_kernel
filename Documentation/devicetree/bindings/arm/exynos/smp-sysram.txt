## Documentation/devicetree/bindings/misc/nvidia,tegra114-mipi.txt
```
NVIDIA Tegra MIPI pad calibration controller

Required properties:
- compatible: "nvidia,tegra<chip>-mipi"
- reg: Physical base address and length of the controller's registers.
- clocks: The clock consumed by the controller.
- #calibrate-cells: Should be 1. The cell is a bitmask of the pads that need
  to be calibrated by a given device.

User nodes need to contain a calibrate property that has a phandle to refer
to the calibration controller node and a bitmask of the pads that need to be
calibrated.

Example:

	mipi: mipi@700e3000 {
		compatible = "nvidia,tegra114-mipi";
		reg = <0x700e3000 0x100>;
		clocks = <&tegra_car TEGRA114_CLK_MIPI_CAL>;
		#calibrate-cells = <1>;
	};

	...

	host1x@50000000 {
		...

		dsi@54300000 {
			...

			calibrate = <&mipi 0x060>;

			...
		};

		...
	};
```

## Documentation/devicetree/bindings/mtd/gpmc-nand.txt
```
Device tree bindings for GPMC connected NANDs

GPMC connected NAND (found on OMAP boards) are represented as child nodes of
the GPMC controller with a name of "nand".

All timing relevant properties as well as generic gpmc child properties are
explained in a separate documents - please refer to
Documentation/devicetree/bindings/bus/ti-gpmc.txt

For NAND specific properties such as ECC modes or bus width, please refer to
Documentation/devicetree/bindings/mtd/nand.txt


Required properties:

 - reg:		The CS line the peripheral is connected to

Optional properties:

 - nand-bus-width: 		Determines data-width of the connected device
				x16 = "16"
				x8  = "8" (default)


 - ti,nand-ecc-opt:		Determines the ECC scheme used by driver.
				It can be any of the following strings:

	"hamming_code_sw"		1-bit Hamming ECC
					- ECC calculation in software
					- Error detection in software
					- ECC layout compatible with S/W scheme

	"hamming_code_hw"		1-bit Hamming ECC
					- ECC calculation in hardware
					- Error detection in software
					- ECC layout compatible with S/W scheme

	"hamming_code_hw_romcode"	1-bit Hamming ECC
					- ECC calculation in hardware
					- Error detection in software
					- ECC layout compatible with ROM code

	"bch4_code_hw_detection_sw"	4-bit BCH ECC
					- ECC calculation in hardware
					- Error detection in software
					- ECC layout compatible with S/W scheme
					* depends on CONFIG_MTD_NAND_ECC_BCH

	"bch4_code_hw"             	4-bit BCH ECC
					- ECC calculation in hardware
					- Error detection in hardware
					- ECC layout compatible with ROM code
					* depends on CONFIG_MTD_NAND_OMAP_BCH
					* requires <elm_id> to be specified

	"bch8_code_hw_detection_sw"	8-bit BCH ECC
					- ECC calculation in hardware
					- Error detection in software
					- ECC layout compatible with S/W scheme
					* depends on CONFIG_MTD_NAND_ECC_BCH

	"bch8_code_hw"             	8-bit BCH ECC
					- ECC calculation in hardware
					- Error detection in hardware
					- ECC layout compatible with ROM code
					* depends on CONFIG_MTD_NAND_OMAP_BCH
					* requires <elm_id> to be specified


 - elm_id:			Specifies elm device node. This is required to
				support some BCH ECC schemes mentioned above.


For inline partiton table parsing (optional):

 - #address-cells: should be set to 1
 - #size-cells: should be set to 1

Example for an AM33xx board:

	gpmc: gpmc@50000000 {
		compatible = "ti,am3352-gpmc";
		ti,hwmods = "gpmc";
		reg = <0x50000000 0x1000000>;
		interrupts = <100>;
		gpmc,num-cs = <8>;
		gpmc,num-waitpins = <2>;
		#address-cells = <2>;
		#size-cells = <1>;
		ranges = <0 0 0x08000000 0x2000>;	/* CS0: NAND */
		elm_id = <&elm>;

		nand@0,0 {
			reg = <0 0 0>; /* CS0, offset 0 */
			nand-bus-width = <16>;
			ti,nand-ecc-opt = "bch8";

			gpmc,sync-clk-ps = <0>;
			gpmc,cs-on-ns = <0>;
			gpmc,cs-rd-off-ns = <44>;
			gpmc,cs-wr-off-ns = <44>;
			gpmc,adv-on-ns = <6>;
			gpmc,adv-rd-off-ns = <34>;
			gpmc,adv-wr-off-ns = <44>;
			gpmc,we-off-ns = <40>;
			gpmc,oe-off-ns = <54>;
			gpmc,access-ns = <64>;
			gpmc,rd-cycle-ns = <82>;
			gpmc,wr-cycle-ns = <82>;
			gpmc,wr-access-ns = <40>;
			gpmc,wr-data-mux-bus-ns = <0>;

			#address-cells = <1>;
			#size-cells = <1>;

			/* partitions go here */
		};
	};
```

## Documentation/devicetree/bindings/pci/msm_pcie.txt
```
MSM PCIe

MSM PCI express root complex

Required properties:
  - compatible: should be "qcom,msm-pcie"
  - reg: should contain PCIe register maps.
  - reg-names: indicates various resources passed to driver by name.
  - interrupts: should contain PCIe related interrupts.
  - interrupt-names: indicates interrupts passed to driver by name.

Optional Properties:
  - <supply-name>-supply: phandle to the regulator device tree node.
    "supply-name" examples are "vdd", "vdd-io".
  - gpios: specifies gpios assigned for PCIe slot.
  - qcom,gpio-names:  a list of strings that map in order to the list
    of gpios. A slot has either gpios or dedicated tlmm pins as represented
    below.

Example:

	pcie0: qcom,pcie@fc520000 {
		compatible = "qcom,msm_pcie";
		rc-index = <0>;
		ctrl-amt = <1>;

		reg = <0xFC520000 0x2000>,
			<0xFF000000 0x1000>,
			<0xFF001000 0x1000>,
			<0xFF100000 0x1000>,
			<0xFF200000 0xE00000>;

		reg-names = "parf", "dm_core", "elbi",
				"conf", "bars";

		#address-cells = <0>;
		interrupt-parent = <&pcie0>;
		interrupts = <0 1 2 3 4 5 6 7 8 9 10 11 12>;
		#interrupt-cells = <1>;
		interrupt-map-mask = <0xffffffff>;
		interrupt-map = <0 &intc 0 243 0
				1 &intc 0 244 0
				2 &intc 0 245 0
				3 &intc 0 247 0
				4 &intc 0 248 0
				5 &intc 0 249 0
				6 &intc 0 250 0
				7 &intc 0 251 0
				8 &intc 0 252 0
				9 &intc 0 253 0
				10 &intc 0 254 0
				11 &intc 0 255 0
				12 &msmgpio 69 0x2>;
		interrupt-names = "int_msi", "int_a", "int_b", "int_c", "int_d",
				"int_pls_pme", "int_pme_legacy", "int_pls_err",
				"int_aer_legacy", "int_pls_link_up",
				"int_pls_link_down", "int_bridge_flush_n",
				"int_wake";

		gpios = <&msmgpio 70 0>,
			<&msmgpio 69 0>,
			<&msmgpio 68 0>;
		qcom,gpio-names = "perst", "wake", "clkreq";

		gdsc_vdd-supply = <&gdsc_pcie_0>;
		PCIe01_1.8-supply = <&pma8084_l12>;
		PCIe01_0.9-supply = <&pma8084_l4>;
		PCIe01_3.3-supply = <&wlan_vreg>;
	};
```

## Documentation/devicetree/bindings/pinctrl/marvell,berlin-pinctrl.txt
```
* Pin-controller driver for the Marvell Berlin SoCs

The pins controlled by the Marvell Berlin controller are organized in groups.
Configuration is done by group, so no actual pin information is needed.

Be aware the Marvell Berlin datasheets use the keyword 'mode' for what is called
a 'function' in the pin-controller subsystem.

Required properties:
- compatible: should be one of:
	"marvell,berlin2-soc-pinctrl",
	"marvell,berlin2-sysmgr-pinctrl",
	"marvell,berlin2cd-soc-pinctrl",
	"marvell,berlin2cd-sysmgr-pinctrl",
	"marvell,berlin2q-soc-pinctrl",
	"marvell,berlin2q-sysmgr-pinctrl"
- reg: registers physical address and length of the pin controller.

Please refer to pinctrl-bindings.txt in this directory for details of the
common pin-controller bindings used by client devices.

A pin-controller node should contain subnodes representing the pin group
configurations, one per function. Each subnode has the group name and the muxing
function used.

Required subnode-properties:
- marvell,groups: a list of strings describing the group names.
- marvell,function: a string describing the function used to mux the groups.

Example:

sm_pinctrl: pin-controller@0 {
	compatible = "marvell,berlin2q-sysmgr-pinctrl";
	reg = <0xfc0000 0x44>;

	uart0_pmux: uart0-pmux {
		marvell,groups = "GSM12", "GSM13";
		marvell,function = "uart0";
	};
}

&uart0 {
	pinctrl-0 = <&uart0_pmux>;
	pinctrl-names = "default";
};
```

## Documentation/devicetree/bindings/platform/msm/qca1530.txt
```
QCA1530 SOC

QCA1530 is a SoC for position determination using sattelite groups. Typical
scenario includes usage of GPS and GLONASS satellite navigation systems.

Required properties for QCA1530

- compatible: "qcom,qca1530"

Optional properties for QCA1530
- gpios: GPIO for reset control
- pwr-supply: handle to the regulator device tree node
- pwr2-supply: handle to the second regulator device tree node
- pwr-gpio: handle the power control using GPIO interface
- clk-gpio: handle the clock control using GPIO interface
- xlna-supply: handle to the regulator for xLNA
- xlna-gpio: handle to xLNA power control using GPIO interface

Example:
	qcom,gnss {
		compatible = "qcom,qca1530";
		gpios = <&msmgpio 128 0>;	/* Reset line */
		pwr-supply = <&pma8084_l26>;	/* Power regulator */
		pwr-gpio = <&msmgpio 66 0>;	/* Power GPIO control */
		clk-gpio = <&msmgpio 17 0>;
		xlna-supply = <&pma8084_l22>;	/* Power for xLNA */
	};

The chip operation requires presence of appropriate clock configuration:
	board-clock.c:
		CLK_LOOKUP("rtc_clk",	div_clk3.c, "qca1530.1"),

	optionally board-clock.c:
		CLK_LOOKUP("tcxo_clk",	div_clk2.c, "qca1530.1"),

	board.c:
		OF_DEV_AUXDATA("qcom,qca1530", 0x0, "qca1530.1", NULL),
```

## Documentation/devicetree/bindings/rtc/maxim,ds1307.txt
```
* Maxim (Dallas) DS1307 and compatible Real Time Clock

For example, compatible chips are Maxim DS1337, Microchip MCP794xx,
STMicroelectronics M41T00 and Epson RX-8025.

Required properties:
- compatible: For example "maxim,ds1307" (see rtc-ds1307.c driver for a full
  list).
- reg: i2c address

Example for DS1307:

ds1307: rtc@68 {
	compatible = "maxim,ds1307";
	reg = <0x68>;
};

Example for MCP79401:

mcp7940x: rtc@6f {
	compatible = "microchip,mcp7940x";
	reg = <0x6f>;
};
```

## Documentation/devicetree/bindings/rtc/rtc-palmas.txt
```
Palmas RTC controller bindings

Required properties:
- compatible:
  - "ti,palmas-rtc" for palma series of the RTC controller
- interrupt-parent: Parent interrupt device, must be handle of palmas node.
- interrupts: Interrupt number of RTC submodule on device.

Optional properties:
- ti,back-battery-charge-enable: The palmas series device like TPS65913 or
	TPS80036 supports the battery backup for powering the RTC when main
	battery is removed or in very low power state. This flag will enable
	the backup battery charging.
- ti,back-battery-charge-low-current: Configure lower charging current. Device
	supports the charging current as < 100mA or >100mA. Low current will
	set as <100mA.

Example:
	palmas: tps65913@58 {
		...
		palmas_rtc: rtc {
			compatible = "ti,palmas-rtc";
			interrupt-parent = <&palmas>;
			interrupts = <8 0>;
			ti,back-battery-charge-enable;
			ti,back-battery-charge-low-current;
		};
		...
	};
```

## Documentation/devicetree/bindings/sound/adi,adau1977.txt
```
Analog devices ADAU1977, ADAU1978, ADAU1979 devicetree bindings

The ADAU1977/ADAU1978/ADAU1979 can either be connected to I2C or a SPI bus.
Depending on the bus type different properties must/can be specified.

Shared required properties:
 - compatible: Must be "adi,adau1977", "adi,adau1978" or adi,adau1979"
 - AVDD-supply: A handle to the power supply connected to the AVDD pin

Shared optional properties:
 - DVDD-supply: A handle to the power supply connected to the DVDD pin. If
   specified the internal LDO will be disabled.
 - reset-gpios: GPIO chip handle and specifier that define which GPIO is
   connected to the chips PD/RST pin. If not specified the reset pin is assumed
   to be hardwired to VCC.
 - adi,micbias: Configures the voltage setting for the MICBIAS pin. If not
   specified the default value will be 8.5 Volts. This property is only valid
   for the ADAU1977.
   Valid values for this property are:
	0: 5.0V
	1: 5.5V
	2: 6.0V
	3: 6.5V
	4: 7.0V
	5: 7.5V
	6: 8.0V
	7: 8.5V
	8: 9.0V

I2C required properties:
 - reg: The I2C address of the chip

SPI required properties:
 - reg: The SPI chipselect signal of the SPI master associated with this chip
 - spi-max-frequency: Maximum spi frequency to use.

Examples:

&i2c_bus {
	adau1977: codec@11 {
		compatible = "adi,adau1977";
		reg = <0x11>;
		reset-gpios = <&gpio 5 0>;
		AVDD-supply = <&codec_avdd_supply>;
		DVDD-supply = <&codec_dvdd_supply>;
	};
};
	
&spi_bus {
	adau1977: codec@1 {
		compatible = "adi,adau1977";
		reg = <0x1>;
		spi-max-frequency = <10000000>;
		AVDD-supply = <&codec_avdd_supply>;
		adi,micbias = <5>;
	};
};
```

## Documentation/devicetree/bindings/sound/adi,adau7002.txt
```
Analog Devices ADAU7002 Stereo PDM-to-I2S/TDM Converter

Required properties:

 - compatible: Should contain "adi,adau7002"
 - IOVDD-supply: Phandle and specifier for the power supply providing IOVDD as
   covered in Documentation/devicetree/bindings/regulator/regulator.txt

Examples:

	adau7002 {
		compatible = "adi,adau7002";
		IOVDD-supply = <&supply>;
	};
```

## Documentation/devicetree/bindings/sound/sirf-i2s.txt
```
* SiRF SoC I2S module

Required properties:
- compatible: "sirf,prima2-i2s"
- reg: Base address and size entries:
- dmas: List of DMA controller phandle and DMA request line ordered pairs.
- dma-names: Identifier string for each DMA request line in the dmas property.
  These strings correspond 1:1 with the ordered pairs in dmas.

  One of the DMA channels will be responsible for transmission (should be
  named "tx") and one for reception (should be named "rx").

- clocks: A phandle of I2S controller clock source
- pinctrl-names: Must contain a "default" entry.
- pinctrl-NNN: One property must exist for each entry in pinctrl-names.

Example:

i2s: i2s@b0040000 {
	compatible = "sirf,prima2-i2s";
	reg = <0xb0040000 0x10000>;
	dmas = <&dmac1 6>, <&dmac1 12>;
	dma-names = "rx", "tx";
	clocks = <&clks 27>;
	pinctrl-names = "default";
	pinctrl-0 = <&i2s_pins_a>;
};
```
