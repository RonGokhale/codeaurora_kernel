## chromeos/drivers/Kconfig
```kconfig
menu "Chromeos Supplied Third-Party Device Drivers"

source "chromeos/drivers/ath6kl/Kconfig"
source "chromeos/drivers/gobi/Kconfig"

endmenu
```

## drivers/android/Kconfig
```kconfig
menu "Android"

config ANDROID_PMEM
	bool "Android pmem allocator"
	default y
	help
		none

endmenu
```

## drivers/gpu/drm/panel/Kconfig
```kconfig
menuconfig DRM_PANEL
	bool "DRM panel support"
	help
	  Panel registration and lookup framework.

if DRM_PANEL

config DRM_PANEL_SIMPLE
	bool "support for simple panels"
	depends on OF
	help
	  DRM panel driver for dumb panels that need at most a regulator and
	  a GPIO to be powered up. Optionally a backlight can be attached so
	  that it can be automatically turned off when the panel goes into a
	  low power state.

endif
```

## drivers/iio/imu/Kconfig
```kconfig
#
# IIO imu drivers configuration
#
menu "Inertial measurement units"

config ADIS16480
	tristate "Analog Devices ADIS16480 and similar IMU driver"
	depends on SPI
	select IIO_ADIS_LIB
	select IIO_ADIS_LIB_BUFFER if IIO_BUFFER
	help
	  Say yes here to build support for Analog Devices adis16375, adis16480,
	  adis16485, adis16488 inertial sensors.

endmenu

config IIO_ADIS_LIB
	tristate
	help
	  A set of IO helper functions for the Analog Devices ADIS* device family.

config IIO_ADIS_LIB_BUFFER
	bool
	select IIO_TRIGGERED_BUFFER
	help
	  A set of buffer helper functions for the Analog Devices ADIS* device
	  family.
```

## drivers/input/misc/Kconfig
```kconfig
config SENSORS_MMA8X5X
	tristate "MMA8451/MMA8452/MMA8453/MMA8652/MMA8653 device driver"
	depends on I2C && SYSFS
	default n
	help
	 If you say yes here you get support for the Freescale MMA8451/
	 MMA8452/MMA8453/MMA8652/MMA8653  sensors.

config SENSORS_MMA_POSITION
	int "MMA8x5x Accelerate Sensor Position Setting"
	depends on SENSORS_MMA8X5X
	default "0"
	help
	 this provide the sensor position setting , value is between 0~7
```

## drivers/media/video/imageon/Kconfig
```kconfig
config VIDEO_IMAGEON
	tristate "Imageon card RX support"
	depends on MEDIA_SUPPORT && VIDEO_V4L2 && I2C && VIDEO_V4L2_SUBDEV_API
	select I2C_ALGOBIT
	select VIDEO_ADV7604
	select VIDEOBUF2_DMA_CONTIG
	---help---
	  To compile this driver as a module, choose M here: the
	  module will be called imageon-rx.
```

## drivers/mmc/core/Kconfig
```kconfig
#
# MMC core configuration
#

config MMC_UNSAFE_RESUME
	bool "Allow unsafe resume (DANGEROUS)"
	help
	  If you say Y here, the MMC layer will assume that all cards
	  stayed in their respective slots during the suspend. The
	  normal behaviour is to remove them at suspend and
	  redetecting them at resume. Breaking this assumption will
	  in most cases result in data corruption.

	  This option is usually just for embedded systems which use
	  a MMC/SD card for rootfs. Most people should say N here.

config MMC_EMBEDDED_SDIO
	boolean "MMC embedded SDIO device support (EXPERIMENTAL)"
	depends on EXPERIMENTAL
	help
	  If you say Y here, support will be added for embedded SDIO
	  devices which do not contain the necessary enumeration
	  support in hardware to be properly detected.
```

## drivers/platform/Kconfig
```kconfig
if X86
source "drivers/platform/x86/Kconfig"
endif
if GOLDFISH
source "drivers/platform/goldfish/Kconfig"
endif
if ARCH_VEXPRESS
source "drivers/platform/vexpress/Kconfig"
endif
```

## drivers/platform/cros/Kconfig
```kconfig
#
# X86 Platform Specific Drivers
#

menuconfig CROS_PLATFORM_DEVICES
	bool "Chrome OS Platform Specific Device Drivers"
	default y
	---help---
	  Say Y here to get to see options for device drivers for various
	  Chrome OS platforms. This option alone does not add any kernel code.

	  If you say N, all options in this submenu will be skipped and disabled.

if CROS_PLATFORM_DEVICES && ARM

config ACPI_CHROMEOS_ARM
	bool "ChromeOS specific ARM extensions"
	default y
	---help---
	  This driver provides the firmware interface for the services exported
	  through the CHROMEOS interfaces when using ChromeOS ARM firmware.

config CHROMEOS
	bool "ChromeOS specific platform functions"
	default y
	---help---
	  This driver provides abstracted interfaces to the firmware features
	  provided on ChromeOS devices. It depends on a lowlevel driver to
	  implement the firmware interface on the platform.

endif # CROS_PLATFORM_DEVICES
```

## drivers/platform/vexpress/Kconfig
```kconfig
config VEXPRESS_SPC
	bool "Versatile Express SPC driver support"
	help
	  The Serial Power Controller (SPC) for ARM Ltd. test chips, is
	  an IP that provides a memory mapped interface to power controller
	  HW. The driver provides an API abstraction meant to be used by
	  subsystem drivers allowing to program registers controlling
	  low-level power management features like power down flags,
	  global and per-cpu wake-up IRQs.
```

## drivers/video/msm/Kconfig
```kconfig
config FB_MSM
	tristate "MSM Frame Buffer support"
	depends on FB && ARCH_MSM
	select FB_BACKLIGHT if FB_MSM_BACKLIGHT
	select NEW_LEDS
	select LEDS_CLASS
	select FB_CFB_FILLRECT
	select FB_CFB_COPYAREA
	select FB_CFB_IMAGEBLIT
	---help---
	  Support for MSM Framebuffer.

if FB_MSM

config FB_MSM_BACKLIGHT
	bool "Support for backlight control"
	default y
	---help---
	  Say Y here if you want to control the backlight of your display.

config FB_MSM_LOGO
	bool "MSM Frame Buffer Logo"
	---help---
	  Show /logo.rle during boot.

config FB_MSM_LCDC_HW
	bool
	default n

choice
	prompt "MDP HW version"
	default FB_MSM_MDP22

config FB_MSM_MDP22
	bool "MDP HW ver2.2"
	---help---
	  Support for MSM MDP HW revision 2.2
	  Say Y here if this is msm7201 variant platform.

config FB_MSM_MDP30
	select FB_MSM_LCDC_HW
	bool "MDP HW ver3.0"
	---help---
	  Support for MSM MDP HW revision 3.0
	  Say Y here if this is msm7x25 variant platform.

config FB_MSM_MDP31
	select FB_MSM_LCDC_HW
	bool "MDP HW ver3.1"
	---help---
	  Support for MSM MDP HW revision 3.1
	  Say Y here if this is msm8x50 variant platform.

config FB_MSM_MDP40
	select FB_MSM_LCDC_HW
	bool "MDP HW ver4.0"
	---help---
	  Support for MSM MDP HW revision 4.0
	  Say Y here if this is msm7x30 variant platform.
endchoice


config FB_MSM_EBI2
	bool
	default n

config FB_MSM_MDDI
	bool
	default n

config FB_MSM_LCDC
	bool
	default n

config FB_MSM_EXTMDDI
	bool
	default n

config FB_MSM_TVOUT
	bool
	default n

config FB_MSM_MDDI_TOSHIBA_COMMON
	bool
	select FB_MSM_MDDI
	default n

config FB_MSM_MDDI_TOSHIBA_COMMON_VGA
	bool
	select FB_MSM_MDDI_TOSHIBA_COMMON
	default n

config FB_MSM_MDDI_AUTO_DETECT
	bool
	select FB_MSM_MDDI
	default n

config FB_MSM_LCDC_PANEL
	bool
	select FB_MSM_LCDC
	default n

config FB_MSM_LCDC_PRISM_WVGA
	bool
	select FB_MSM_LCDC_PANEL
	default n

config FB_MSM_LCDC_GORDON_VGA
	bool
	select FB_MSM_LCDC_PANEL
	default n

config FB_MSM_LCDC_GRAPEFRUIT_VGA
	bool
	select FB_MSM_LCDC_PANEL
	default n

config FB_MSM_LCDC_ST1_WXGA
	bool
	select FB_MSM_LCDC_PANEL
	default n

config FB_MSM_LCDC_WXGA
	bool
	select FB_MSM_LCDC_PANEL
	default n

choice
	prompt "LCD Panel"
	default FB_MSM_MDDI_AUTO_DETECT

config FB_MSM_LCDC_PRISM_WVGA_PANEL
	depends on FB_MSM_LCDC_HW
	bool "LCDC Prism WVGA Panel"
	select FB_MSM_LCDC_PRISM_WVGA
	---help---
	  Support for LCDC Prism WVGA (800x480) panel

config FB_MSM_LCDC_GORDON_VGA_PANEL
	depends on FB_MSM_LCDC_HW
	bool "LCDC Gordon VGA Panel"
	select FB_MSM_LCDC_GORDON_VGA
	---help---
	  Support for LCDC Gordon VGA (480x640) panel

config FB_MSM_LCDC_GRAPEFRUIT_PANEL
	depends on FB_MSM_LCDC_HW
	bool "LCDC Grapefruit VGA Panel"
	select FB_MSM_LCDC_GRAPEFRUIT_VGA
	---help---
	  Support for Grapefruit VGA (1024x600) panel

config FB_MSM_LCDC_ST1_PANEL
	depends on FB_MSM_LCDC_HW
	bool "LCDC ST1 WXGA Panel"
	select FB_MSM_LCDC_ST1_WXGA
	---help---
	  Support for ST1 WXGA (1280x720) panel

config FB_MSM_TRY_MDDI_CATCH_LCDC_PRISM
	depends on FB_MSM_LCDC_HW
	bool "MDDI Panel Auto Detect + LCDC Prism WVGA"
	select FB_MSM_MDDI_AUTO_DETECT
	select FB_MSM_LCDC_PRISM_WVGA
	select FB_MSM_LCDC_GORDON_VGA
	select FB_MSM_LCDC_WXGA
	select FB_MSM_LCDC_GRAPEFRUIT_VGA
	select FB_MSM_LCDC_ST1_WXGA
	---help---
	  Support for MDDI panel auto detect.
	  If it can't find any MDDI panel, it will load LCDC Prism WVGA panel.

config FB_MSM_MDDI_PANEL_AUTO_DETECT
	bool "MDDI Panel Auto Detect"
	select FB_MSM_MDDI_AUTO_DETECT
	---help---
	  Support for MDDI panel auto detect

config FB_MSM_MDDI_PRISM_WVGA
	bool "MDDI Prism WVGA Panel"
	select FB_MSM_MDDI
	---help---
	  Support for MDDI Prism WVGA (800x480) panel

config FB_MSM_MDDI_TOSHIBA_WVGA_PORTRAIT
	bool "MDDI Toshiba WVGA Portrait Panel"
	select FB_MSM_MDDI_TOSHIBA_COMMON
	---help---
	  Support for MDDI Toshiba WVGA (480x800) panel

config FB_MSM_MDDI_TOSHIBA_VGA
	bool "MDDI Toshiba VGA Panel"
	select FB_MSM_MDDI_TOSHIBA_COMMON_VGA
	---help---
	  Support for MDDI Toshiba VGA (480x640) and QCIF (176x220) panel

config FB_MSM_MDDI_TOSHIBA_WVGA
	bool "MDDI Toshiba WVGA panel"
	select FB_MSM_MDDI_TOSHIBA_COMMON
	---help---
	  Support for MDDI Toshiba (800x480) WVGA panel

config FB_MSM_MDDI_SHARP_QVGA_128x128
	bool "MDDI Sharp QVGA Dual Panel"
	select FB_MSM_MDDI
	---help---
	  Support for MDDI Sharp QVGA (240x320) and 128x128 dual panel

config FB_MSM_EBI2_TMD_QVGA_EPSON_QCIF
	bool "EBI2 TMD QVGA Epson QCIF Dual Panel"
	select FB_MSM_EBI2
	---help---
	  Support for EBI2 TMD QVGA (240x320) and Epson QCIF (176x220) panel

config FB_MSM_PANEL_NONE
	bool "NONE"
	---help---
	  This will disable LCD panel
endchoice

choice
	prompt "Secondary LCD Panel"
	depends on  FB_MSM_MDP31
	default FB_MSM_SECONDARY_PANEL_NONE

config FB_MSM_LCDC_EXTERNAL_WXGA
	depends on FB_MSM_MDP31
	bool "External WXGA on LCDC"
	select FB_MSM_LCDC_PANEL
	---help---
	  Support for external WXGA display (1280x720)

config FB_MSM_SECONDARY_PANEL_NONE
	bool "NONE"
	---help---
	  No secondary panel
endchoice

config FB_MSM_TVOUT_NTSC
	bool
	select FB_MSM_TVOUT
	default n

config FB_MSM_TVOUT_PAL
	bool
	select FB_MSM_TVOUT
	default n

choice
	depends on  (FB_MSM_MDP22 || FB_MSM_MDP31)
	prompt "TVOut Region"
	default FB_MSM_TVOUT_NTSC_M

config FB_MSM_TVOUT_NTSC_M
	bool "NTSC M"
	select FB_MSM_TVOUT_NTSC
	---help---
	  Support for NTSC M region (North American and Korea)

config FB_MSM_TVOUT_NTSC_J
	select FB_MSM_TVOUT_NTSC
	bool "NTSC J"
	---help---
	  Support for NTSC J region (Japan)

config FB_MSM_TVOUT_PAL_BDGHIN
	select FB_MSM_TVOUT_PAL
	bool "PAL BDGHIN"
	---help---
	  Support for PAL BDGHIN region (Non-argentina PAL-N)

config FB_MSM_TVOUT_PAL_M
	select FB_MSM_TVOUT_PAL
	bool "PAL M"
	---help---
	  Support for PAL M region

config FB_MSM_TVOUT_PAL_N
	select FB_MSM_TVOUT_PAL
	bool "PAL N"
	---help---
	  Support for PAL N region (Argentina PAL-N)

config FB_MSM_TVOUT_NONE
	bool "NONE"
	---help---
	  This will disable TV Out functionality.
endchoice

choice
	depends on  FB_MSM_MDP22
	prompt "External MDDI"
	default FB_MSM_EXTMDDI_SVGA

config FB_MSM_EXTMDDI_SVGA
	bool "External MDDI SVGA"
	select FB_MSM_MDDI
	select FB_MSM_EXTMDDI
	---help---
	  Support for MSM SVGA (800x600) external MDDI panel

config FB_MSM_EXTMDDI_NONE
	bool "NONE"
	---help---
	  This will disable External MDDI functionality.
endchoice

endif
```

## sound/soc/tegra/Kconfig
```kconfig
config TEGRA_ALSA
    tristate "Tegra ALSA SoC support"
    select SND_SOC_WM8903
    help
       Say Y if you want to add support for codec attached to
       alsa interface on tegra.
       TEGRA_ALSA and TEGRA_I2S_AUDIO options are mutually exclusive.
```
